## sdkconfig.defaults.ble
```kconfig
# BLE Configuration Improvements
CONFIG_BTDM_SCAN_DUPL_CACHE_SIZE=500
CONFIG_BTDM_SCAN_DUPL_CACHE_REFRESH_PERIOD=100
CONFIG_BT_NIMBLE_HIGH_DUTY_ADV_ITVL=y
CONFIG_BT_NIMBLE_ENC_ADV_DATA=y
CONFIG_BT_NIMBLE_HOST_ALLOW_CONNECT_WITH_SCAN=y

# Additional BLE configurations for better stability
CONFIG_BT_NIMBLE_MAX_CONNECTIONS=4
CONFIG_BT_NIMBLE_MAX_BONDS=4
CONFIG_BT_NIMBLE_MAX_CCCDS=8
CONFIG_BT_NIMBLE_L2CAP_COC_MAX_NUM=8

# Increase advertising interval range for better visibility
CONFIG_BT_NIMBLE_ADV_FAST_INT_MIN_DFLT=48
CONFIG_BT_NIMBLE_ADV_FAST_INT_MAX_DFLT=96

# Scan configuration for better device discovery
CONFIG_BT_NIMBLE_SCAN_ACTIVE=y
CONFIG_BT_NIMBLE_SCAN_FAST_INTERVAL_DFLT=96
CONFIG_BT_NIMBLE_SCAN_FAST_WINDOW_DFLT=48
```
